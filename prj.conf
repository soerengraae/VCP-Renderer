## CMakeLists.txt
```
cmake_minimum_required(VERSION 3.20.0)
find_package(Zephyr REQUIRED HINTS $ENV{ZEPHYR_BASE})

project(VCP_Renderer)

target_sources(app PRIVATE src/main.c)
target_sources(app PRIVATE src/volumeControlService.c)
target_sources(app PRIVATE src/bluetoothManager.c)
target_sources(app PRIVATE src/peripherals.c)
```

## prj.conf
```kconfig
# Bluetooth peripheral
CONFIG_BT=y
CONFIG_BT_PERIPHERAL=y
CONFIG_BT_HCI_ERR_TO_STR=y
CONFIG_BT_DEVICE_NAME="VCP Server"

# Logging
CONFIG_LOG=y
CONFIG_LOG_MODE_DEFERRED=y
# CONFIG_ASSERT=y
```

## src/main.c
```c
/**
 * @file main.c
 * @brief VCP Renderer main application entry point
 *
 * Initializes all subsystems for the Volume Control Profile Renderer demonstration
 * and starts the Bluetooth advertising process. The application runs event-driven
 * with no main loop to conserve power.
 */

#include <zephyr/kernel.h>
#include <zephyr/bluetooth/bluetooth.h>
#include <zephyr/bluetooth/conn.h>
#include <zephyr/bluetooth/gatt.h>
#include <zephyr/bluetooth/hci.h>
#include <zephyr/logging/log.h>

#include "volumeControlService.h"
#include "bluetoothManager.h"
#include "peripherals.h"

LOG_MODULE_REGISTER(main, 4);

/**
 * @brief Initialize all application subsystems
 * @details Initializes peripherals (LED, button) and Bluetooth stack in sequence.
 *          Critical failures in LED or Bluetooth will cause initialization to fail.
 *          Button failure is non-critical and only generates a warning.
 * @return 1 on success, 0 on failure
 */
uint8_t init() {
	// Initialize peripherals
	if (!initStatusLED()) {
		LOG_ERR("Status LED initialization failed\n");
		return 0;
	}

	if (!initButton()) {
		LOG_WRN("Info button initialization failed\n");
	}

	// Initialize Bluetooth
	if (!initBluetooth()) {
		LOG_ERR("Bluetooth initialization failed\n");
		return 0;
	}

	return 1;
}

/**
 * @brief Main application entry point
 * @details Initializes all subsystems and starts the VCP Renderer service.
 *          The application is event-driven and does not run a main loop to save power.
 *          All functionality is handled through Bluetooth callbacks and work queues.
 * @return 0 on successful initialization, -1 on failure
 */
int main(void)
{
	if (!init()) {
		LOG_ERR("Initialization failed. Stopping.\n");
		return -1;
	}

	return 0;
}
```

## src/VolumeControlService.c
```c
/**
 * @file volumeControlService.c
 * @brief Bluetooth Volume Control Service implementation
 *
 * Implements the Volume Control Service GATT characteristics and handlers
 * according to the Bluetooth Volume Control Profile specification.
 */

#include "volumeControlService.h"

LOG_MODULE_REGISTER(vcs, 4);

/** @brief Volume flags state for Volume Flags characteristic (0x2B7F) */
uint8_t volumeFlags = 0x00;

/** @brief Track if Volume State notifications are enabled via CCCD */
static bool notifyStateEnabled;

/** @brief Track if Volume Flags notifications are enabled via CCCD */
static bool notifyFlagsEnabled;

/** @brief Current volume state - initialized to mid-range volume, unmuted */
struct volumeState vcsState = {
	.volumeSetting = 128,  // Mid-range volume
	.mute = 0,            // Unmuted
	.changeCounter = 0,   // Initial synchronization counter
};

void notifyVolumeState(struct bt_conn *conn) {
    if (notifyStateEnabled) {
        bt_gatt_notify(conn, &vcsSvc.attrs[2], &vcsState, sizeof(vcsState));
    }
}

/* GATT read handler for Volume State (0x2B7D) */
ssize_t readVolumeState(struct bt_conn *conn, const struct bt_gatt_attr *attr, void *buf, uint16_t len, uint16_t offset)
{
	return bt_gatt_attr_read(conn, attr, buf, len, offset, &vcsState, sizeof(vcsState));
}

/* GATT read handler for Volume State Flags (0x2B7F) */
ssize_t readVolumeFlags(struct bt_conn *conn, const struct bt_gatt_attr *attr, void *buf, uint16_t len, uint16_t offset)
{
	return bt_gatt_attr_read(conn, attr, buf, len, offset, &volumeFlags, sizeof(volumeFlags));
}

/* Volume State Characteristic Client Configuration Descriptor (CCCD) changed handler */
void volumeStateCccdChanged(const struct bt_gatt_attr *attr, uint16_t value)
{
	LOG_DBG("Volume State CCCD changed: %u\n", value);
	notifyStateEnabled = (value == BT_GATT_CCC_NOTIFY);
}

/* Volume Flags Characteristic Client Configuration Descriptor (CCCD) changed handler */
void volumeFlagsCccdChanged(const struct bt_gatt_attr *attr, uint16_t value)
{
	LOG_DBG("Volume Flags CCCD changed: %u\n", value);
	notifyFlagsEnabled = (value == BT_GATT_CCC_NOTIFY);
}

/**
 * @note The flags should ideally be stored in non-volatile memory along with the volume state
 *       but that is however not implemented in this demonstration.
 */
void volumeFlagsSet(uint8_t flags, struct bt_conn *conn) {
	volumeFlags = flags;
	if (notifyFlagsEnabled) {
		bt_gatt_notify(conn, &vcsSvc.attrs[7], &volumeFlags, sizeof(volumeFlags));
	}
}

/* ========== Volume Control Opcode Implementations ========== */

/**
 * @brief Implements VCP VOLUME_DOWN opcode
 * @details Decreases volume by VOLUME_STEP_SIZE with lower bound protection.
 *          Fulfills VCP equation: Volume_Setting = max(VolumeSetting - Step Size, 0)
 */
void volumeDown(uint8_t *volume) {
	*volume = *volume == VOLUME_MIN ? VOLUME_MIN : *volume - VOLUME_STEP_SIZE;
	LOG_DBG("Volume down: %d\n", *volume);
}

/**
 * @brief Implements VCP VOLUME_UP opcode
 * @details Increases volume by VOLUME_STEP_SIZE with upper bound protection.
 *          Fulfills VCP equation: Volume_Setting = min(VolumeSetting + Step Size, 255)
 */
void volumeUp(uint8_t *volume) {
	*volume = *volume == VOLUME_MAX ? VOLUME_MAX : *volume + VOLUME_STEP_SIZE;
	LOG_DBG("Volume up: %d\n", *volume);
}

/**
 * @brief Implements VCP VOLUME_SET_ABSOLUTE opcode
 * @details Sets volume to exact value without bounds checking (client responsibility).
 *          Fulfills VCP equation: Volume_Setting = New Volume
 */
void volume_set(uint8_t *volume, uint8_t new_volume) {
	*volume = new_volume;
	LOG_DBG("Volume set: %d\n", *volume);
}

void volumeUnmute(void) {
	vcsState.mute = 0;
	LOG_DBG("Volume unmuted\n");
}

void volumeMute(void) {
	vcsState.mute = 1;
	LOG_DBG("Volume muted\n");
}

void changeCounterIncrement(struct bt_conn *conn) {
	vcsState.changeCounter++;
	notifyVolumeState(conn);
}

/* GATT write handler for Volume Control Point (0x2B7E) */
ssize_t writeVolumeControlPoint(struct bt_conn *conn, const struct bt_gatt_attr *attr, const void *buf, uint16_t len, uint16_t offset, uint8_t flags)
{
	if (offset != 0 || (len != 2 && len != 3)) {
		LOG_WRN("Invalid attribute length: %d\n", len);
		return BT_GATT_ERR(BT_ATT_ERR_INVALID_ATTRIBUTE_LEN);
	}

	uint8_t opcode = ((uint8_t *)buf)[0];
	uint8_t operand = ((uint8_t *)buf)[1];

	if (operand != vcsState.changeCounter) {
		LOG_WRN("Invalid Change Counter: %d (expected %d)\n", operand, vcsState.changeCounter);
		return BT_GATT_ERR(ERR_INVALID_CHANGE_COUNTER);
	}

	switch (opcode) {
		case VOLUME_DOWN:
			LOG_DBG("Opcode: VOLUME_DOWN\n");
			volumeDown(&vcsState.volumeSetting);
			break;
		case VOLUME_UP:
			LOG_DBG("Opcode: VOLUME_UP\n");
			volumeUp(&vcsState.volumeSetting);
			break;
		case VOLUME_DOWN_UNMUTE:
			LOG_DBG("Opcode: VOLUME_DOWN_UNMUTE\n");
			volumeDown(&vcsState.volumeSetting);
			volumeUnmute();
			break;
		case VOLUME_UP_UNMUTE:
			LOG_DBG("Opcode: VOLUME_UP_UNMUTE\n");
			volumeUp(&vcsState.volumeSetting);
			volumeUnmute();
			break;
		case VOLUME_SET_ABSOLUTE:
			LOG_DBG("Opcode: VOLUME_SET_ABSOLUTE\n");
			if (len != 3) {
				LOG_WRN("Invalid attribute length for VOLUME_SET_ABSOLUTE: %d\n", len);
				return BT_GATT_ERR(BT_ATT_ERR_INVALID_ATTRIBUTE_LEN);
			}
			operand = ((uint8_t *)buf)[2]; // Casting it to uint8_t makes sure it's in 0-255 range
			volume_set(&vcsState.volumeSetting, operand);
			break;
		case VOLUME_UNMUTE:
			LOG_DBG("Opcode: VOLUME_UNMUTE\n");
			volumeUnmute();
			break;
		case VOLUME_MUTE:
			LOG_DBG("Opcode: VOLUME_MUTE\n");
			volumeMute();
			break;

		default:
			LOG_WRN("Invalid Opcode: %d\n", opcode);
			return BT_GATT_ERR(ERR_INVALID_OPCODE);
	}

	switch (opcode) {
		case VOLUME_DOWN:
		case VOLUME_UP:
		case VOLUME_DOWN_UNMUTE:
		case VOLUME_UP_UNMUTE:
		case VOLUME_SET_ABSOLUTE:
			volumeFlagsSet((0x01 << 0), conn); // Volume changed - set Volume_Setting_Persisted flag
			break;

		default:
			break;
	}

	changeCounterIncrement(conn);

	return len; // Success - return number of bytes processed
}
```

## src/VolumeControlService.h
```c
/**
 * @file volumeControlService.h
 * @brief Bluetooth Volume Control Service (VCS) implementation
 *
 * This module implements the Bluetooth Volume Control Profile (VCP) Renderer role,
 * providing a GATT service that allows remote clients to control volume settings.
 * Complies with Bluetooth VCP specification for volume state management and control.
 */

#ifndef VOLUMECONTROLSERVICE_H
#define VOLUMECONTROLSERVICE_H

#include <zephyr/kernel.h>
#include <zephyr/bluetooth/bluetooth.h>
#include <zephyr/bluetooth/gatt.h>
#include <zephyr/logging/log.h>

/** @brief Volume adjustment step size for relative volume changes */
#define VOLUME_STEP_SIZE 10

/** @brief Maximum volume level (0-255 range per VCP spec) */
#define VOLUME_MAX 255

/** @brief Minimum volume level */
#define VOLUME_MIN 0

/** @brief Volume Control Service GATT service definition */
extern const struct bt_gatt_service_static vcsSvc;

/**
 * @brief VCP-specific error codes for Volume Control Point operations
 *
 * These error codes are returned when Volume Control Point writes fail
 * due to protocol violations or invalid parameters.
 */
enum ERROR_CODES {
  ERR_INVALID_CHANGE_COUNTER = 0x80,  /**< Change counter mismatch */
  ERR_INVALID_OPCODE = 0x81,          /**< Unsupported or invalid opcode */
};

/**
 * @brief Volume Control Point opcodes per VCP specification
 *
 * These opcodes define the supported volume control operations that can
 * be written to the Volume Control Point characteristic (0x2B7E).
 */
enum OPCODES {
  VOLUME_DOWN,          /**< Decrease volume by step size */
  VOLUME_UP,            /**< Increase volume by step size */
  VOLUME_DOWN_UNMUTE,   /**< Decrease volume and unmute */
  VOLUME_UP_UNMUTE,     /**< Increase volume and unmute */
  VOLUME_SET_ABSOLUTE,  /**< Set absolute volume level */
  VOLUME_UNMUTE,        /**< Unmute without changing volume */
  VOLUME_MUTE           /**< Mute without changing volume */
};

/**
 * @brief Volume state structure matching VCP Volume State characteristic (0x2B7D)
 *
 * This structure represents the current volume state that gets exposed via
 * the Volume State characteristic and sent in notifications when changes occur.
 */
struct volumeState {
	uint8_t volumeSetting;  /**< Current volume level (0-255) */
	uint8_t mute;          /**< Mute state: 0=unmuted, 1=muted */
	uint8_t changeCounter; /**< Synchronization counter for client coordination */
};

/** @brief Volume flags characteristic value (0x2B7F) */
extern uint8_t volumeFlags;

/** @brief Current volume state exposed via Volume State characteristic */
extern struct volumeState vcsState;

/**
 * @brief Send volume state notification to connected client
 * @param conn Bluetooth connection handle
 */
void notifyVolumeState(struct bt_conn *conn);

/**
 * @brief GATT read handler for Volume State characteristic (0x2B7D)
 * @param conn Bluetooth connection handle
 * @param attr GATT attribute being read
 * @param buf Output buffer for read data
 * @param len Maximum bytes to read
 * @param offset Read offset into characteristic value
 * @return Number of bytes read on success, negative error code on failure
 */
ssize_t readVolumeState(struct bt_conn *conn, const struct bt_gatt_attr *attr, void *buf, uint16_t len, uint16_t offset);

/**
 * @brief GATT read handler for Volume Flags characteristic (0x2B7F)
 * @param conn Bluetooth connection handle
 * @param attr GATT attribute being read
 * @param buf Output buffer for read data
 * @param len Maximum bytes to read
 * @param offset Read offset into characteristic value
 * @return Number of bytes read on success, negative error code on failure
 */
ssize_t readVolumeFlags(struct bt_conn *conn, const struct bt_gatt_attr *attr, void *buf, uint16_t len, uint16_t offset);

/**
 * @brief Volume State CCCD change handler
 * @param attr GATT attribute (CCCD) that changed
 * @param value New CCCD value (notifications enabled/disabled)
 */
void volumeStateCccdChanged(const struct bt_gatt_attr *attr, uint16_t value);

/**
 * @brief Volume Flags CCCD change handler
 * @param attr GATT attribute (CCCD) that changed
 * @param value New CCCD value (notifications enabled/disabled)
 */
void volumeFlagsCccdChanged(const struct bt_gatt_attr *attr, uint16_t value);

/**
 * @brief Update volume flags and notify clients if enabled
 * @param flags New volume flags value
 * @param conn Bluetooth connection handle for notifications
 */
void volumeFlagsSet(uint8_t flags, struct bt_conn *conn);

/**
 * @brief GATT write handler for Volume Control Point characteristic (0x2B7E)
 * @details Processes VCP opcodes according to Bluetooth VCP specification.
 *          Validates change counter for operation synchronization.
 * @param conn Bluetooth connection handle
 * @param attr GATT attribute being written
 * @param buf Input buffer containing opcode and parameters
 * @param len Length of input buffer (2-3 bytes expected)
 * @param offset Write offset (must be 0)
 * @param flags GATT write flags
 * @return Number of bytes processed on success, negative error code on failure
 */
ssize_t writeVolumeControlPoint(struct bt_conn *conn, const struct bt_gatt_attr *attr, const void *buf, uint16_t len, uint16_t offset, uint8_t flags);

/**
 * @brief Decrease volume by step size with bounds checking
 * @param volume Pointer to current volume level to modify
 */
void volumeDown(uint8_t *volume);

/**
 * @brief Increase volume by step size with bounds checking
 * @param volume Pointer to current volume level to modify
 */
void volumeUp(uint8_t *volume);

/**
 * @brief Set mute state to muted
 */
void volumeMute(void);

/**
 * @brief Set mute state to unmuted
 */
void volumeUnmute(void);

/**
 * @brief Increment change counter and notify volume state change
 * @param conn Bluetooth connection handle for notifications
 */
void changeCounterIncrement(struct bt_conn *conn);

#endif
```

## src/bluetoothManager.c
```c
#include "bluetoothManager.h"
#include "peripherals.h"

LOG_MODULE_REGISTER(bt_mgr, 4);

struct k_work adv_start_work;

struct bt_data ad[] = {
  BT_DATA_BYTES(BT_DATA_NAME_SHORTENED, BT_DEVICE_NAME_SHORT),
	BT_DATA_BYTES(BT_DATA_FLAGS, (BT_LE_AD_GENERAL | BT_LE_AD_NO_BREDR)),
	BT_DATA_BYTES(BT_DATA_UUID16_ALL, 0x44, 0x18), /* 0x1844 VCS (little-endian)*/
};

/* GATT: Primary service */
BT_GATT_SERVICE_DEFINE(vcsSvc,
	BT_GATT_PRIMARY_SERVICE(BT_UUID_VCS),
	BT_GATT_CHARACTERISTIC(BT_UUID_VCS_STATE,
		BT_GATT_CHRC_READ | BT_GATT_CHRC_NOTIFY,
		BT_GATT_PERM_READ,
		readVolumeState, NULL, &vcsState),
	BT_GATT_CCC(volumeStateCccdChanged, BT_GATT_PERM_READ | BT_GATT_PERM_WRITE),
	BT_GATT_CHARACTERISTIC(BT_UUID_VCS_CONTROL,
		BT_GATT_CHRC_WRITE,
		BT_GATT_PERM_WRITE,
		NULL, writeVolumeControlPoint, NULL),
	BT_GATT_CHARACTERISTIC(BT_UUID_VCS_FLAGS,
		BT_GATT_CHRC_READ | BT_GATT_CHRC_NOTIFY,
		BT_GATT_PERM_READ,
		readVolumeFlags, NULL, &volumeFlags),
	BT_GATT_CCC(volumeFlagsCccdChanged, BT_GATT_PERM_READ | BT_GATT_PERM_WRITE),
);

void connected(struct bt_conn *conn, uint8_t err)
{
	char addr[BT_ADDR_LE_STR_LEN];
	bt_addr_le_to_str(bt_conn_get_dst(conn), addr, sizeof(addr));

	if (err) {
		LOG_ERR("Connection failed, err 0x%02x %s\n", err, bt_hci_err_to_str(err));
	} else {
		LOG_DBG("Connected to %s\n", addr);
		k_work_cancel_delayable(&statusLedWork);
		gpio_pin_set_dt(&statusLed, 1); // Turn on LED
	}
}

void disconnected(struct bt_conn *conn, uint8_t reason)
{
	LOG_DBG("Disconnected, reason 0x%02x %s\n", reason, bt_hci_err_to_str(reason));
	k_work_submit(&adv_start_work);
	k_work_schedule(&statusLedWork, K_MSEC(1000));
}

BT_CONN_CB_DEFINE(conn_callbacks) = {
	.connected = connected,
	.disconnected = disconnected,
};

void adv_start_handler(struct k_work *work)
{
	(void)(work);

	LOG_DBG("Starting advertisement\n");
	int err = bt_le_adv_start(BT_LE_ADV_CONN_FAST_1, ad, ARRAY_SIZE(ad), NULL, 0);
	if (err) {
		LOG_ERR("Advertising failed to start (%d)\n", err);
	} else {
		LOG_DBG("Advertising as connectable peripheral\n");
	}
}

void bt_ready(int err)
{
	if (err) {
		LOG_ERR("Bluetooth init failed (%d)\n", err);
		return;
	}

	LOG_DBG("Bluetooth ready\n");

	k_work_init(&adv_start_work, adv_start_handler);
	k_work_submit(&adv_start_work);
}

uint8_t initBluetooth(void) {
	int err;

	err = bt_enable(bt_ready);
	if (err) {
		LOG_ERR("bt_enable failed (%d)\n", err);
		return false;
	}

	return true;
}
```

## src/bluetoothManager.h
```c
/**
 * @file bluetoothManager.h
 * @brief Bluetooth stack management and connection handling
 *
 * Manages Bluetooth Low Energy advertising, connections, and GATT service
 * registration for the Volume Control Profile Renderer implementation.
 */

#ifndef CONNECTION_MANAGER_H
#define CONNECTION_MANAGER_H

#include <zephyr/kernel.h>
#include <zephyr/bluetooth/bluetooth.h>
#include <zephyr/bluetooth/conn.h>
#include <zephyr/bluetooth/gatt.h>
#include <zephyr/bluetooth/hci.h>
#include <zephyr/logging/log.h>
#include "volumeControlService.h"

/** @brief Full device name from configuration */
#define BT_DEVICE_NAME_FULL CONFIG_BT_DEVICE_NAME

/** @brief Shortened device name for advertising */
#define BT_DEVICE_NAME_SHORT "Renderer"

/** @brief Work item for deferred advertising restart */
extern struct k_work adv_start_work;

/** @brief Volume Control Service GATT service definition */
extern const struct bt_gatt_service_static vcsSvc;

/**
 * @brief Bluetooth LE advertising data
 * @details Contains:
 * - Device Name (shortened)
 * - BLE Flags (General Discoverable, BR/EDR not supported)
 * - Volume Control Service UUID: 0x1844
 */
extern struct bt_data ad[];

/**
 * @brief Bluetooth connection established callback
 * @param conn Bluetooth connection handle
 * @param err Connection error code (0 = success)
 */
void connected(struct bt_conn *conn, uint8_t err);

/**
 * @brief Bluetooth connection terminated callback
 * @param conn Bluetooth connection handle
 * @param reason Disconnection reason code
 */
void disconnected(struct bt_conn *conn, uint8_t reason);

/**
 * @brief Work handler to restart advertising
 * @param work Work item that triggered this handler
 */
void adv_start_handler(struct k_work *work);

/**
 * @brief Bluetooth stack ready callback
 * @param err Bluetooth initialization error code (0 = success)
 */
void bt_ready(int err);

/**
 * @brief Initialize Bluetooth stack and start advertising
 * @return 1 on success, 0 on failure
 */
uint8_t initBluetooth(void);

#endif
```

## src/peripherals.c
```c
#include "peripherals.h"
#include "volumeControlService.h"

LOG_MODULE_REGISTER(peripherals, 4);

struct gpio_dt_spec infoButton = GPIO_DT_SPEC_GET_OR(DT_ALIAS(sw0), gpios, {0});
struct gpio_dt_spec statusLed = GPIO_DT_SPEC_GET(DT_ALIAS(led1), gpios);
struct k_work_delayable statusLedWork;
struct gpio_callback buttonCb;

void statusLedHandler(struct k_work *work)
{
	(void)(work);

	gpio_pin_toggle_dt(&statusLed);
	k_work_schedule(&statusLedWork, K_MSEC(1000));
}

void buttonPressed(const struct device *dev, struct gpio_callback *cb, uint32_t pins)
{
	LOG_INF("\nVolume State:\n");
	LOG_INF("  Volume Setting: %d\n", vcsState.volumeSetting);
	LOG_INF("  Mute: %d\n", vcsState.mute);
	LOG_INF("  Change Counter: %d\n", vcsState.changeCounter);

	LOG_INF("Volume Flags:\n");
	LOG_INF("  Volume_Setting_Persisted: %d\n", (volumeFlags & 0x01)); // Get's the first bit (not really needed since it's the only one defined anyway)
}

uint8_t initButton(void) {
  int ret;

  if (!gpio_is_ready_dt(&infoButton)) {
		LOG_ERR("Error: info button device %s is not ready\n", infoButton.port->name);
		return 0;
	}

	ret = gpio_pin_configure_dt(&infoButton, GPIO_INPUT);
	if (ret != 0) {
		LOG_ERR("Error %d: failed to configure %s pin %d\n", ret, infoButton.port->name, infoButton.pin);
		return 0;
	}

	ret = gpio_pin_interrupt_configure_dt(&infoButton, GPIO_INT_EDGE_TO_ACTIVE);
	if (ret != 0) {
		LOG_ERR("Error %d: failed to configure interrupt on %s pin %d\n", ret, infoButton.port->name, infoButton.pin);
		return 0;
	}

	gpio_init_callback(&buttonCb, buttonPressed, BIT(infoButton.pin));
	gpio_add_callback(infoButton.port, &buttonCb);

	if (ret != 0) {
		LOG_ERR("Failed to initialize info button: %d\n", ret);
		return 0;
	}

	return 1;
}

uint8_t initStatusLED(void) {
  int ret;

  if (!device_is_ready(statusLed.port)) {
		LOG_ERR("Status LED device not ready\n");
		return 0;
	}

	ret = gpio_pin_configure_dt(&statusLed, GPIO_OUTPUT_ACTIVE);
	if (ret != 0) {
		LOG_ERR("Failed to configure status LED pin: %d\n", ret);
		return 0;
	}

	k_work_init_delayable(&statusLedWork, statusLedHandler);
	k_work_schedule(&statusLedWork, K_MSEC(1000));

  return 1;
}
```

## src/peripherals.h
```c
/**
 * @file peripherals.h
 * @brief GPIO peripheral management for nRF52DK board
 *
 * Handles status LED and button interactions for the VCP Renderer demonstration.
 * Provides visual feedback for Bluetooth connection status and user input handling.
 */

#ifndef PERIPHERALS_H
#define PERIPHERALS_H

#include <zephyr/kernel.h>
#include <zephyr/autoconf.h>
#include <zephyr/drivers/gpio.h>
#include <zephyr/logging/log.h>

/** @brief GPIO specification for info button (typically button 1 on nRF52DK) */
extern struct gpio_dt_spec infoButton;

/** @brief GPIO specification for status LED (typically LED 1 on nRF52DK) */
extern struct gpio_dt_spec statusLed;

/** @brief Delayable work item for LED blinking during advertising */
extern struct k_work_delayable statusLedWork;

/** @brief GPIO callback structure for button press handling */
extern struct gpio_callback buttonCb;

/**
 * @brief Work handler for status LED blinking
 * @param work Work item that triggered this handler
 */
void statusLedHandler(struct k_work *work);

/**
 * @brief GPIO interrupt callback for button presses
 * @param dev GPIO device that triggered the interrupt
 * @param cb GPIO callback structure
 * @param pins Bitmask of pins that triggered the interrupt
 */
void buttonPressed(const struct device *dev, struct gpio_callback *cb, uint32_t pins);

/**
 * @brief Initialize info button GPIO and interrupt
 * @return 1 on success, 0 on failure
 */
uint8_t initButton(void);

/**
 * @brief Initialize status LED GPIO and work queue
 * @return 1 on success, 0 on failure
 */
uint8_t initStatusLED(void);

#endif
```
